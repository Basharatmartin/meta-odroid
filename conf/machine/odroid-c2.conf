## conf/machine/odroid-c2.conf
```bitbake
#@TYPE: Machine
#@NAME: odroid-c2
#@DESCRIPTION: Machine configuration for odroid-c2 systems
#@MAINTAINER: Armin Kuster <akuster808@gmail.com>

require conf/machine/include/arm/arch-armv8.inc
include conf/machine/include/odroid-default-settings.inc

MACHINE_EXTRA_RRECOMMENDS = " kernel-modules"

EXTRA_IMAGEDEPENDS += "u-boot-hardkernel"

SDCARD_ROOTFS ?= "${DEPLOY_DIR_IMAGE}/${IMAGE_NAME}.rootfs.ext4"
IMAGE_FSTYPES ?= "ext4 tar.bz2 sdcard "

SERIAL_CONSOLE = "115200 ttyS0"

PREFERRED_PROVIDER_virtual/kernel ?= "linux-hardkernel"
PREFERRED_VERSION_linux-hardkernel ?= "3.14%"

#specify u-boot parameters
PREFERRED_PROVIDER_virtual/bootloader ?= "u-boot-hardkernel"
PREFERRED_PROVIDER_u-boot ?= "u-boot-hardkernel"
PREFERRED_VERSION_u-boot-hardkernel ?= "2015.01"
UBOOT_MACHINE_odroid-c2 = "odroidc2_defconfig"

KERNEL_IMAGETYPE ?= "Image"
UBOOT_BINARY ?= "u-boot.bin"

MACHINE_FEATURES = "serial usbgadget usbhost vfat ext2 rtc alsa screen"
```
